## cale/main/Kconfig.projbuild
```kconfig
menu "Example Configuration"

    config BLINK_GPIO
        int "Blink GPIO number"
        range 0 34
        default 5
        help
            GPIO number (IOxx) to blink on and off.

            Some GPIOs are used for other purposes (flash connections, etc.) and cannot be used to blink.

            GPIOs 35-39 are input-only so cannot be used as outputs.


    config ESP_WIFI_SSID
        string "WiFi SSID"
        default "KabelBox-A210"
        help
            SSID (network name) for the example to connect to.

    config ESP_WIFI_PASSWORD
        string "WiFi Password"
        default "14237187131701431551"
        help
            WiFi password (WPA or WPA2) for the example to use.

    config ESP_MAXIMUM_RETRY
        int "Maximum retry"
        default 5
        help
            Set the Maximum retry to avoid station reconnecting to the AP unlimited when the AP is really inexistent.

endmenu
```

## components/CalEPD/Kconfig.projbuild
```kconfig
menu "Display Configuration"
    comment "Fill only EPD entries for single SPI displays (Good display/Waveshare)"
    comment "Mosi and Clock should be set for any epaper"
    config EINK_SPI_MOSI
        int "EPD SPI: GPIO for MOSI (DIN in epaper) * Universal MOSI"
        range 0 35
        default 23
    config EINK_SPI_CLK
        int "EPD SPI: GPIO for Clock                * Universal CLK"
        range 0 37
        default 18
    config EINK_SPI_CS
        int "EPD SPI: GPIO for Chip Select"
        range -1 34
        default 32
    config EINK_DC
        int "EPD: GPIO for DC"
        range -1 34
        default 27
    config EINK_RST
        int "EPD: GPIO for Reset"
        range -1 34
        default 26
    config EINK_BUSY
        int "EPD: GPIO for Busy signal - DONE for Good Display/Waveshare einks! Leave rest on 0 unless is Wave12I48 or PlasticLogic"
        range -1 39
        default 35
    
    comment "Important: Leave the rest of unconfigured GPIOs to -1 unless multi-SPI channels (wave12I48) or Plasticlogic EPDs"
    comment "CS2 and MISO pins apply only to Plasticlogic.com epaper displays"
    
    config EINK_SPI_CS2
        int "EPD SPI: GPIO for Chip Select2"
        range -1 34
        default 4
    config EINK_SPI_MISO
        int "EPD SPI: GPIO for MISO"
        range -1 36
        default 19
        
    comment "Config below applies to 4 epaper module wave12I48 w/4 SPI CS & BUSY pins (14 pins)"
    comment "| S2 | M2 |"
    comment "-----------"
    comment "| M1 | S1 |"
    config EINK_SPI_M1_CS
        int "* CS M1"
        range 0 23
        default 23
    config EINK_SPI_S1_CS
        int "* CS S1"
        range 0 23
        default 22
    config EINK_SPI_M2_CS
        int "* CS M2 do not use 16-17 when using PSRAM"
        range 0 27
        default 16
    config EINK_SPI_S2_CS
        int "* CS S2"
        range 0 23
        default 19

    config EINK_SPI_M1_BUSY
        int "* BUSY M1"
        range 0 32
        default 32
    config EINK_SPI_S1_BUSY
        int "* BUSY S1"
        range 0 32
        default 26
    config EINK_SPI_M2_BUSY
        int "* BUSY M2"
        range 0 32
        default 18
    config EINK_SPI_S2_BUSY
        int "* BUSY S2"
        range 0 32
        default 4

    config EINK_M1S1_DC
        int "* M1S1_DC: M1 & S1 share DC & RST"
        range 0 25
        default 25
    config EINK_M2S2_DC
        int "* M2S2_DC do not use 16-17 when using PSRAM"
        range 0 27
        default 17
    config EINK_M1S1_RST
        int "* M1S1_RST"
        range 0 33
        default 33
    config EINK_M2S2_RST
        int "* M2S2_RST"
        range 0 33
        default 5
endmenu
```

## components/Epdiy-IDF/Kconfig.projbuild
```kconfig
menu "I2S data bus Configuration"
    comment "I2S data lines and clock. Defaults to LILYGO epaper"

    config D0
        int "Data Bus 0"
        range 5 37
        default 33
    config D1
        int "Data Bus 1"
        range 5 37
        default 32
    config D2
        int "Data Bus 2"
        range 4 37
        default 4
    config D3
        int "Data Bus 3"
        range 5 37
        default 19
    config D4
        int "Data Bus 4"
        range 2 37
        default 2
    config D5
        int "Data Bus 5"
        range 5 37
        default 27
    config D6
        int "Data Bus 6"
        range 5 37
        default 21
    config D7
        int "Data Bus 7"
        range 5 37
        default 22

    config CKV
        int "Data control line"
        range 20 25
        default 25
    config CKH
        int "Data clock pin"
        range 0 5
        default 5
    config STH
        int "Start pulse: enabling data input on the slave device (active low)"
        range 26 37
        default 26

    config CFG_DATA
        int "Data config register data"
        range 20 25
        default 23
    config CFG_CLK
        int "Data config register clock"
        range 18 18
        default 18
    config CFG_STR
        int "Data config register string"
        range 0 19
        default 0

endmenu
```

## components/FT6X36-IDF/Kconfig.projbuild
```kconfig
menu "Touch FT6X36 Configuration"
    comment "The touch chip needs an I2C port and one input GPIO"
    config TOUCH_SDA
        int "I2C data SDA"
        range 0 35
        default 21
    config TOUCH_SDL
        int "I2C clock SDL"
        range 0 37
        default 22
    config TOUCH_INT
        int "Touch interrupt: On LOW reads the data via I2C (Input pullup)"
        range -1 34
        default 17
    config I2C_MASTER_FREQUENCY
        int "I2C Frequency"
        range 50000 500000

    config FT6X36_DEBUG
        int "FT6X36 debug: On 1 will output FocalTech touch events via serial"
        range 0 1
        default 0
    config FT6X36_DEBUG_EVENTS
        int "FT6X36 debug events: On 1 will output touch events only"
        range 0 1
        default 0
endmenu
```

## main/Kconfig.projbuild
```kconfig
menu "CALE Configuration"

    config ESP_WIFI_SSID
        string "WiFi SSID"
        default "KabelBox-A210"
        help
            SSID (network name) for the Firmware.

    config ESP_WIFI_PASSWORD
        string "WiFi Password"
        default ""
        help
            WiFi password (WPA or WPA2)

    config CALE_SCREEN_URL
        string "Screen URL to the Bitmap (1, 4, 8 or 24 bits per pixel)"
        default "http://cale.es"
        help
            This can be an URL to the image web-service CALE.es

    config CALE_BEARER_TOKEN
        string "Security token only for private Screens protected with Authentication: Bearer (Max. 65 chars)"
        default ""
        help
            Leave empty if your Screen is public in CALE.es

    config DEEPSLEEP_MINUTES_AFTER_RENDER
        int "Minutes that the ESP32 goes to deepsleep after display rendering."
        range 5 1440
        default 60
    
    config ESP_TRIGGER_SENSOR1
        int "RISING: Trigger a new image request when the pin goes from LOW to HIGH cale-sensor example (0 to disable)"
        range 0 33
        default 27

    config DISPLAY_ROTATION
        int "Display rotation: 0 = default 1 = 90° clockwise 2 = 180° 3 = 270°"
        range 0 3
        default 0

    config ESP_MAXIMUM_RETRY
        int "Maximum retry for trying to reconnect to WiFi"
        default 5
        help
            Set the Maximum retry to avoid station reconnecting to the AP unlimited times.

endmenu
menu "ESP RainMaker App Wi-Fi Provisioning"

    config APP_WIFI_PROV_SHOW_QR
        bool "Show provisioning QR code"
        default y
        help
            Show the QR code for provisioning.

    choice APP_WIFI_PROV_TRANSPORT
        bool "Provisioning Transport method"
        default APP_WIFI_PROV_TRANSPORT_BLE
        help
            Wi-Fi provisioning component offers both, SoftAP and BLE transports. Choose any one.

        config APP_WIFI_PROV_TRANSPORT_SOFTAP
            bool "Soft AP"
        config APP_WIFI_PROV_TRANSPORT_BLE
            bool "BLE"
            select BT_ENABLED
            depends on IDF_TARGET_ESP32 || IDF_TARGET_ESP32C3
    endchoice

    config APP_WIFI_PROV_TRANSPORT
        int
        default 1 if APP_WIFI_PROV_TRANSPORT_SOFTAP
        default 2 if APP_WIFI_PROV_TRANSPORT_BLE

    config APP_WIFI_SHOW_DEMO_INTRO_TEXT
        bool "Show intro text for demos"
        default n
        help
            Show some intro text for demos in order to help users understand more about ESP RainMaker.

endmenu
```

## main/www-jpg-render/main/Kconfig.projbuild
```kconfig
menu "CALE Configuration"

    config ESP_WIFI_SSID
        string "WiFi SSID"
        default "WLAN-724300"
        help
            SSID (network name) for the Firmware.

    config ESP_WIFI_PASSWORD
        string "WiFi Password"
        default ""
        help
            WiFi password (WPA or WPA2)

    config DEEPSLEEP_MINUTES_AFTER_RENDER
        int "Minutes that the ESP32 goes to deepsleep after display rendering."
        range 5 1440
        default 60

    config DISPLAY_ROTATION
        int "Display rotation: 0 = default 1 = 90° clockwise 2 = 180° 3 = 270°"
        range 0 3
        default 0

endmenu
```
